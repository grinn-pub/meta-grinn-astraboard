## conf/layer.conf
```bitbake
# We have a conf and classes directory, add to BBPATH
BBPATH .= ":${LAYERDIR}"

# We have recipes-* directories, add to BBFILES
BBFILES += "${LAYERDIR}/recipes-*/*/*.bb \
            ${LAYERDIR}/recipes-*/*/*.bbappend"

BBFILE_COLLECTIONS += "meta-grinn-astraboard"
BBFILE_PATTERN_meta-grinn-astraboard = "^${LAYERDIR}/"
BBFILE_PRIORITY_meta-grinn-astraboard = "6"

LAYERDEPENDS_meta-grinn-astraboard = "core"
LAYERSERIES_COMPAT_meta-grinn-astraboard = "kirkstone"
```

## conf/machine/grinnastraevb.conf
```bitbake
#@TYPE: Machine
#@NAME: grinn astra evb board
#@DESCRIPTION: Machine configuration for the Grinn AstraEvb-1680


include conf/machine/sl1680.conf

MACHINEOVERRIDES =. "sl1680:"

SYNA_KERNEL_DTS_FILE = "synaptics/grinn-astraevb.dtb"
```
